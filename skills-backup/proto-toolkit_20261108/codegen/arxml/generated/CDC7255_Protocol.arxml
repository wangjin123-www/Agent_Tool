AUTOSAR XML (schema 4-2-2)
package /CDC7255/DataTypes
  app type uint16: category=VALUE, base-type=uint16
  impl type uint16_Impl: category=VALUE, base-type=uint16
  app type uint32: category=VALUE, base-type=uint32
  impl type uint32_Impl: category=VALUE, base-type=uint32
  app type uint8: category=VALUE, base-type=uint8
  impl type uint8_Impl: category=VALUE, base-type=uint8
  app type MPU_REQ_DATA_SYNC: category=VALUE, base-type=uint8, compu {0=REQUEST, 1=NO_REQUEST}
  impl type MPU_REQ_DATA_SYNC_Impl: category=VALUE, base-type=uint8, compu {0=REQUEST, 1=NO_REQUEST}
  app type RESET_TYPE: category=VALUE, base-type=uint8, compu {0=RESET_MPU, 1=RESET_MCU, 2=RESET_TOUCH_KEY, 3=RESET_FACTORY}
  impl type RESET_TYPE_Impl: category=VALUE, base-type=uint8, compu {0=RESET_MPU, 1=RESET_MCU, 2=RESET_TOUCH_KEY, 3=RESET_FACTORY}
  compu method HEARTBEAT_SET_CompuMethod: 0=HB_SET_COMM_ON, 1=HB_SET_COMM_OFF, 2=HB_SET_FAST_ON, 3=HB_SET_FAST_OFF
  app type HEARTBEAT_SET: category=VALUE, base-type=uint8, compu-method=HEARTBEAT_SET_CompuMethod
  impl type HEARTBEAT_SET_Impl: category=VALUE, base-type=uint8, compu-method=HEARTBEAT_SET_CompuMethod
  app type HEARTBEAT_STATE: category=VALUE, base-type=uint8, compu {0=HEARTBEAT_OK, 1=HEARTBEAT_TIMEOUT}
  impl type HEARTBEAT_STATE_Impl: category=VALUE, base-type=uint8, compu {0=HEARTBEAT_OK, 1=HEARTBEAT_TIMEOUT}
  compu method POWER_MGMT_REQ_CompuMethod: 0=PWR_PREPARE_SLEEP_READY, 1=PWR_EXIT_DELAY_WORK, 2=PWR_BATT_TOO_HIGH_READY, 3=PWR_BATT_TOO_LOW_READY, 4=PWR_ENTRY_STANDBY, 5=PWR_EXIT_STANDBY, 6=PWR_ENTRY_CLOCK_MODE, 7=PWR_EXIT_CLOCK_MODE, 8=PWR_ENTRY_HALF_RUN, 9=PWR_EXIT_HALF_RUN, 255=PWR_REQ_INVALID
  app type POWER_MGMT_REQ: category=VALUE, base-type=uint8, compu-method=POWER_MGMT_REQ_CompuMethod
  impl type POWER_MGMT_REQ_Impl: category=VALUE, base-type=uint8, compu-method=POWER_MGMT_REQ_CompuMethod
  app type STR_STATE: category=VALUE, base-type=uint8, compu {0=STR_NOT_IN_STR, 1=STR_PREPARE_ENTRY}
  impl type STR_STATE_Impl: category=VALUE, base-type=uint8, compu {0=STR_NOT_IN_STR, 1=STR_PREPARE_ENTRY}
  app type STR_DEBUG: category=VALUE, base-type=uint8, compu {0=STR_DEBUG_OFF, 1=STR_DEBUG_1MIN, 2=STR_DEBUG_5MIN, 3=STR_DEBUG_30MIN}
  impl type STR_DEBUG_Impl: category=VALUE, base-type=uint8, compu {0=STR_DEBUG_OFF, 1=STR_DEBUG_1MIN, 2=STR_DEBUG_5MIN, 3=STR_DEBUG_30MIN}
  compu method IC_POWER_STATE_CompuMethod: 0=IC_PWR_INIT, 1=IC_PWR_RUN, 2..5=IC_PWR_STANDBY1..IC_PWR_STANDBY4, 6=IC_PWR_STR, 7=IC_PWR_STR_PREPARE, 8=IC_PWR_STR_ENTER, 9=IC_PWR_STR_FAILED, 10=IC_PWR_REMOTE_CTRL, 11=IC_PWR_UPDATE
  app type IC_POWER_STATE: category=VALUE, base-type=uint8, compu-method=IC_POWER_STATE_CompuMethod
  impl type IC_POWER_STATE_Impl: category=VALUE, base-type=uint8, compu-method=IC_POWER_STATE_CompuMethod
  compu method HEARTBEAT_STATUS_CompuMethod: 0=HB_STS_COMM_ON, 1=HB_STS_COMM_OFF, 2=HB_STS_FAST_ON, 3=HB_STS_FAST_OFF
  app type HEARTBEAT_STATUS: category=VALUE, base-type=uint8, compu-method=HEARTBEAT_STATUS_CompuMethod
  impl type HEARTBEAT_STATUS_Impl: category=VALUE, base-type=uint8, compu-method=HEARTBEAT_STATUS_CompuMethod
  compu method POWER_MGMT_STATUS_CompuMethod: 0=PWR_ST_UNKNOWN, 1=PWR_ST_HALF_RUN, 2=PWR_ST_RUNNING, 3=PWR_ST_EXTEND_RUN, 4=PWR_ST_STANDBY, 5=PWR_ST_PRE_SLEEP, 6=PWR_ST_SLEEP, 7=PWR_ST_DEEP_SLEEP, 8=PWR_ST_BATT_HIGH, 9=PWR_ST_BATT_LOW, 10=PWR_ST_STR
  app type POWER_MGMT_STATUS: category=VALUE, base-type=uint8, compu-method=POWER_MGMT_STATUS_CompuMethod
  impl type POWER_MGMT_STATUS_Impl: category=VALUE, base-type=uint8, compu-method=POWER_MGMT_STATUS_CompuMethod
  app type ACC_STATUS: category=VALUE, base-type=uint8, compu {0=ACC_OFF, 1=ACC_ON, 2=IGN_ON, 3=ACC_START}
  impl type ACC_STATUS_Impl: category=VALUE, base-type=uint8, compu {0=ACC_OFF, 1=ACC_ON, 2=IGN_ON, 3=ACC_START}
  compu method BATTERY_STATUS_CompuMethod: 0=BATTERY_NORMAL, 1=BATTERY_HIGH, 2=BATTERY_LOW, 3=BATTERY_OVER, 4=BATTERY_UNDER, 5=BATTERY_INVALID
  app type BATTERY_STATUS: category=VALUE, base-type=uint8, compu-method=BATTERY_STATUS_CompuMethod
  impl type BATTERY_STATUS_Impl: category=VALUE, base-type=uint8, compu-method=BATTERY_STATUS_CompuMethod
  compu method AUTOSAR_NM_MODE_CompuMethod: 0=NM_MODE_BUS_SLEEP, 1=NM_MODE_PREPARE_BUS_SLEEP, 2=NM_MODE_SYNCHRONIZED, 3=NM_MODE_NETWORK
  app type AUTOSAR_NM_MODE: category=VALUE, base-type=uint8, compu-method=AUTOSAR_NM_MODE_CompuMethod
  impl type AUTOSAR_NM_MODE_Impl: category=VALUE, base-type=uint8, compu-method=AUTOSAR_NM_MODE_CompuMethod
  compu method AUTOSAR_NM_STATE_CompuMethod: 0=NM_STATE_UNINITIALIZED, 1=NM_STATE_BUS_SLEEP, 2=NM_STATE_PREPARE_BUS_SLEEP, 3=NM_STATE_READY_SLEEP, 4=NM_STATE_NORMAL_OPERATION, 5=NM_STATE_REPEAT_MESSAGE, 6=NM_STATE_SYNCHRONIZED, 7=NM_STATE_WAIT_CHECK_ACTIVATION, 8=NM_STATE_WAIT_NETWORK_STARTUP
  app type AUTOSAR_NM_STATE: category=VALUE, base-type=uint8, compu-method=AUTOSAR_NM_STATE_CompuMethod
  impl type AUTOSAR_NM_STATE_Impl: category=VALUE, base-type=uint8, compu-method=AUTOSAR_NM_STATE_CompuMethod
  compu method VEHICLE_ANTI_THEFT_STS_CompuMethod: 0=ANTI_DISALARMED, 1=ANTI_PRE_ALARMED, 2=ANTI_FULL_ALARMED, 3=ANTI_ALARMED
  app type VEHICLE_ANTI_THEFT_STS: category=VALUE, base-type=uint8, compu-method=VEHICLE_ANTI_THEFT_STS_CompuMethod
  impl type VEHICLE_ANTI_THEFT_STS_Impl: category=VALUE, base-type=uint8, compu-method=VEHICLE_ANTI_THEFT_STS_CompuMethod
  app type REMOTE_CTRL_ST: category=VALUE, base-type=uint8, compu {0=REMOTE_CTRL_NONE, 1=REMOTE_CTRL_ACTIVE}
  impl type REMOTE_CTRL_ST_Impl: category=VALUE, base-type=uint8, compu {0=REMOTE_CTRL_NONE, 1=REMOTE_CTRL_ACTIVE}
  compu method OTA_REQ_STS_CompuMethod: 0=OTA_REQ_NONE, 1=OTA_REQ_FLAG_SAVED, 2=OTA_REQ_START, 3=OTA_REQ_DONE_REBOOT, 4=OTA_REQ_CANCEL
  app type OTA_REQ_STS: category=VALUE, base-type=uint8, compu-method=OTA_REQ_STS_CompuMethod
  impl type OTA_REQ_STS_Impl: category=VALUE, base-type=uint8, compu-method=OTA_REQ_STS_CompuMethod
  compu method OTA_UPGRADE_STS_CompuMethod: 0=OTA_STS_NONE, 1=OTA_STS_FLAG_SAVED, 2=OTA_STS_READY, 3=OTA_STS_COND_UNSAT, 4=OTA_STS_FILE_DONE, 5=OTA_STS_REQ_TIMEOUT, 6=OTA_STS_ERASE_FAIL, 7=OTA_STS_WRITE_FAIL, 8=OTA_STS_SIGN_FAIL, 9=OTA_STS_HASH_FAIL, 10=OTA_STS_CANCEL
  app type OTA_UPGRADE_STS: category=VALUE, base-type=uint8, compu-method=OTA_UPGRADE_STS_CompuMethod
  impl type OTA_UPGRADE_STS_Impl: category=VALUE, base-type=uint8, compu-method=OTA_UPGRADE_STS_CompuMethod
  app type POWER_REQ_CMD: category=VALUE, base-type=uint8, compu {0=PWR_REQ_STR, 1=PWR_REQ_SHUTDOWN, 2=PWR_REQ_RESTART}
  impl type POWER_REQ_CMD_Impl: category=VALUE, base-type=uint8, compu {0=PWR_REQ_STR, 1=PWR_REQ_SHUTDOWN, 2=PWR_REQ_RESTART}
  app type TEMPERATURE_STATUS: category=VALUE, base-type=uint8, compu {0=TEMP_UNDER, 1=TEMP_LOW, 2=TEMP_NORMAL, 3=TEMP_HIGH, 4=TEMP_OVER}
  impl type TEMPERATURE_STATUS_Impl: category=VALUE, base-type=uint8, compu {0=TEMP_UNDER, 1=TEMP_LOW, 2=TEMP_NORMAL, 3=TEMP_HIGH, 4=TEMP_OVER}
  compu method VOLTAGE_STATUS_CompuMethod: 0=VOLTAGE_UNDER, 1=VOLTAGE_LOW, 2=VOLTAGE_NORMAL, 3=VOLTAGE_HIGH, 4=VOLTAGE_OVER, 5=VOLTAGE_DISCONNECT
  app type VOLTAGE_STATUS: category=VALUE, base-type=uint8, compu-method=VOLTAGE_STATUS_CompuMethod
  impl type VOLTAGE_STATUS_Impl: category=VALUE, base-type=uint8, compu-method=VOLTAGE_STATUS_CompuMethod
  app type RESTART_TYPE: category=VALUE, base-type=uint8, compu {0=RESTART_POWER_ON, 1=RESTART_WAKE_UP}
  impl type RESTART_TYPE_Impl: category=VALUE, base-type=uint8, compu {0=RESTART_POWER_ON, 1=RESTART_WAKE_UP}
  application array data type UpgradeDataPkg_upgrade_data_Array: category=ARRAY
    application array element Element: type=uint8, max-number-of-elements=255
  impl type UpgradeDataPkg_upgrade_data_Array_Impl: category=ARRAY
    element Element: implementation-data-type=uint8_Impl, array-size=255
  application record data type DateTime: category=STRUCTURE
    6 x application record element, all with category=VALUE, type=uint8:
      year  # byte 0; bit 0-7bit / 年
      month  # byte 1; bit 0-7bit / 月
      day  # byte 2; bit 0-7bit / 日
      hour  # byte 3; bit 0-7bit / 时
      minute  # byte 4; bit 0-7bit / 分
      second  # byte 5; bit 0-7bit / 秒
  impl type DateTime_Impl: category=STRUCTURE
    6 x element, all with category=TYPE_REFERENCE, sw-bit-representation={bit-position=0, number-of-bits=8}, implementation-data-type=uint8_Impl:
      year  # byte 0; bit 0-7bit / 年
      month  # byte 1; bit 0-7bit / 月
      day  # byte 2; bit 0-7bit / 日
      hour  # byte 3; bit 0-7bit / 时
      minute  # byte 4; bit 0-7bit / 分
      second  # byte 5; bit 0-7bit / 秒
  application record data type PeripheralStatus: category=STRUCTURE
    application record element can1: category=VALUE, type=uint8  # byte 0; bit 0-7bit / CAN1：0=在线/1=故障
    application record element can2: category=VALUE, type=uint8  # byte 1; bit 0-7bit / CAN2：0=在线/1=故障
    application record element other: category=VALUE, type=uint8  # byte 2; bit 0-7bit / 其它外设状态
  impl type PeripheralStatus_Impl: category=STRUCTURE
    element can1: sw-bit-representation={bit-position=0, number-of-bits=8}, implementation-data-type=uint8_Impl  # byte 0; bit 0-7bit / CAN1：0=在线/1=故障
    element can2: sw-bit-representation={bit-position=0, number-of-bits=8}, implementation-data-type=uint8_Impl  # byte 1; bit 0-7bit / CAN2：0=在线/1=故障
    element other: sw-bit-representation={bit-position=0, number-of-bits=8}, implementation-data-type=uint8_Impl  # byte 2; bit 0-7bit / 其它外设状态
  application record data type AutosarNmStatus: category=STRUCTURE
    application record element nm_mode: category=VALUE, type=AUTOSAR_NM_MODE  # byte 0; bit 0-7bit / Autosar网络管理模式
    application record element nm_state: category=VALUE, type=AUTOSAR_NM_STATE  # byte 1; bit 0-7bit / Autosar网络管理状态
  impl type AutosarNmStatus_Impl: category=STRUCTURE
    element nm_mode: sw-bit-representation={bit-position=0, number-of-bits=8}, implementation-data-type=AUTOSAR_NM_MODE_Impl  # byte 0; bit 0-7bit / Autosar网络管理模式
    element nm_state: sw-bit-representation={bit-position=0, number-of-bits=8}, implementation-data-type=AUTOSAR_NM_STATE_Impl  # byte 1; bit 0-7bit / Autosar网络管理状态
  application record data type UpgradeFileInfo: category=STRUCTURE
    application record element file_size: category=VALUE, type=uint32  # byte 0-3; bit 0-31bit / 文件大小 BYTE0-3（byte3-byte0）
    application record element frame_upgrade_data_len: category=VALUE, type=uint16  # byte 4-5; bit 0-15bit / 数据分包长度 BYTE4-5（byte1-byte0）
    application record element total_pkg_num: category=VALUE, type=uint32  # byte 6-9; bit 0-31bit / 包序号总数 BYTE6-9（byte3-byte0）
  impl type UpgradeFileInfo_Impl: category=STRUCTURE
    element file_size: implementation-data-type=uint32_Impl  # byte 0-3; bit 0-31bit / 文件大小 BYTE0-3（byte3-byte0）
    element frame_upgrade_data_len: implementation-data-type=uint16_Impl  # byte 4-5; bit 0-15bit / 数据分包长度 BYTE4-5（byte1-byte0）
    element total_pkg_num: implementation-data-type=uint32_Impl  # byte 6-9; bit 0-31bit / 包序号总数 BYTE6-9（byte3-byte0）
  application record data type UpgradeDataPkg: category=STRUCTURE
    application record element pkg_seq: category=VALUE, type=uint32  # byte 0-3; bit 0-31bit / 包序号 BYTE0-3（从 0 开始递增）
    application record element data_len: category=VALUE, type=uint16  # byte 4-5; bit 0-15bit / 本包数据长度（字节数）
    application record element upgrade_data: category=ARRAY, type=UpgradeDataPkg_upgrade_data_Array  # byte 6..N(open); bit 0-7bit / 升级包数据 BYTE6-N，末包以 0xFF 填充
  impl type UpgradeDataPkg_Impl: category=STRUCTURE
    element pkg_seq: implementation-data-type=uint32_Impl  # byte 0-3; bit 0-31bit / 包序号 BYTE0-3（从 0 开始递增）
    element data_len: implementation-data-type=uint16_Impl  # byte 4-5; bit 0-15bit / 本包数据长度（字节数）
    element upgrade_data: implementation-data-type=UpgradeDataPkg_upgrade_data_Array_Impl  # byte 6..N(open); bit 0-7bit / 升级包数据 BYTE6-N，末包以 0xFF 填充
  application record data type StrMaxDuration: category=STRUCTURE
    application record element function: category=VALUE, type=uint8  # byte 0; bit 0-7bit / 0 关闭 / 1 打开 / 2 读取状态
    application record element hours: category=VALUE, type=uint8  # byte 1; bit 0-7bit / 0 - 7×24 小时
  impl type StrMaxDuration_Impl: category=STRUCTURE
    element function: sw-bit-representation={bit-position=0, number-of-bits=8}, implementation-data-type=uint8_Impl  # byte 0; bit 0-7bit / 0 关闭 / 1 打开 / 2 读取状态
    element hours: sw-bit-representation={bit-position=0, number-of-bits=8}, implementation-data-type=uint8_Impl  # byte 1; bit 0-7bit / 0 - 7×24 小时
  application record data type VehicleSignalStatus: category=STRUCTURE
    application record element ign_state: category=VALUE, type=uint8  # byte 0; bit 0-7bit / 0 IGN OFF / 1 IGN ON / 0xFF 无效
    application record element vehicle_ign_state: category=VALUE, type=uint8  # byte 1; bit 0-7bit / 0 IGN_OFF / 1 IGN_ACC / 2 IGN_ON / 3 IGN_START
  impl type VehicleSignalStatus_Impl: category=STRUCTURE
    element ign_state: sw-bit-representation={bit-position=0, number-of-bits=8}, implementation-data-type=uint8_Impl  # byte 0; bit 0-7bit / 0 IGN OFF / 1 IGN ON / 0xFF 无效
    element vehicle_ign_state: sw-bit-representation={bit-position=0, number-of-bits=8}, implementation-data-type=uint8_Impl  # byte 1; bit 0-7bit / 0 IGN_OFF / 1 IGN_ACC / 2 IGN_ON / 3 IGN_START
  application record data type PowerOffReqResult: category=STRUCTURE
    application record element powerReqCmd: category=VALUE, type=uint8  # byte 0; bit 0-7bit / 0 请求STR / 1 请求关机 / 2 请求重启
    application record element result: category=VALUE, type=uint8  # byte 1; bit 0-7bit / 0 成功 / 非0 错误码
  impl type PowerOffReqResult_Impl: category=STRUCTURE
    element powerReqCmd: sw-bit-representation={bit-position=0, number-of-bits=8}, implementation-data-type=uint8_Impl  # byte 0; bit 0-7bit / 0 请求STR / 1 请求关机 / 2 请求重启
    element result: sw-bit-representation={bit-position=0, number-of-bits=8}, implementation-data-type=uint8_Impl  # byte 1; bit 0-7bit / 0 成功 / 非0 错误码
  application record data type PowerStateSyncResult: category=STRUCTURE
    application record element powerState: category=VALUE, type=uint8  # byte 0; bit 0-7bit / 高4bit OTA模式 / 低4bit SoC电源状态
    application record element result: category=VALUE, type=uint8  # byte 1; bit 0-7bit / 0 成功 / 非0 错误码
  impl type PowerStateSyncResult_Impl: category=STRUCTURE
    element powerState: sw-bit-representation={bit-position=0, number-of-bits=8}, implementation-data-type=uint8_Impl  # byte 0; bit 0-7bit / 高4bit OTA模式 / 低4bit SoC电源状态
    element result: sw-bit-representation={bit-position=0, number-of-bits=8}, implementation-data-type=uint8_Impl  # byte 1; bit 0-7bit / 0 成功 / 非0 错误码
  application record data type PeripheralPowerReq: category=STRUCTURE
    application record element power_type: category=VALUE, type=uint8  # byte 0; bit 0-7bit / 外设类型 0x00 背光 / 0x01 功放 / 0x02 中控屏幕 / 0x03 仪表屏幕
    application record element on_off: category=VALUE, type=uint8  # byte 1; bit 0-7bit / 0x00 关闭 / 0x01 打开
  impl type PeripheralPowerReq_Impl: category=STRUCTURE
    element power_type: sw-bit-representation={bit-position=0, number-of-bits=8}, implementation-data-type=uint8_Impl  # byte 0; bit 0-7bit / 外设类型 0x00 背光 / 0x01 功放 / 0x02 中控屏幕 / 0x03 仪表屏幕
    element on_off: sw-bit-representation={bit-position=0, number-of-bits=8}, implementation-data-type=uint8_Impl  # byte 1; bit 0-7bit / 0x00 关闭 / 0x01 打开
  application record data type PeripheralPowerAck: category=STRUCTURE
    application record element power_type: category=VALUE, type=uint8  # byte 0; bit 0-7bit / 外设类型 0x00 背光 / 0x01 功放 / 0x02 中控屏幕 / 0x03 仪表屏幕
    application record element result: category=VALUE, type=uint8  # byte 1; bit 0-7bit / 0x00 成功 / 非0 错误码
  impl type PeripheralPowerAck_Impl: category=STRUCTURE
    element power_type: sw-bit-representation={bit-position=0, number-of-bits=8}, implementation-data-type=uint8_Impl  # byte 0; bit 0-7bit / 外设类型 0x00 背光 / 0x01 功放 / 0x02 中控屏幕 / 0x03 仪表屏幕
    element result: sw-bit-representation={bit-position=0, number-of-bits=8}, implementation-data-type=uint8_Impl  # byte 1; bit 0-7bit / 0x00 成功 / 非0 错误码
  application record data type McuPowerReq: category=STRUCTURE
    application record element ctrl_type: category=VALUE, type=uint8  # byte 0; bit 0-7bit / 控制类型 0x00 保留 / 0x01 请求控制 VBUS 电源
    application record element ctrl_cmd: category=VALUE, type=uint8  # byte 1; bit 0-7bit / 0x00 关闭 / 0x01 打开 / 0x02 重启
  impl type McuPowerReq_Impl: category=STRUCTURE
    element ctrl_type: sw-bit-representation={bit-position=0, number-of-bits=8}, implementation-data-type=uint8_Impl  # byte 0; bit 0-7bit / 控制类型 0x00 保留 / 0x01 请求控制 VBUS 电源
    element ctrl_cmd: sw-bit-representation={bit-position=0, number-of-bits=8}, implementation-data-type=uint8_Impl  # byte 1; bit 0-7bit / 0x00 关闭 / 0x01 打开 / 0x02 重启
  application record data type McuPowerAck: category=STRUCTURE
    application record element ctrl_type: category=VALUE, type=uint8  # byte 0; bit 0-7bit / 控制类型 0x00 保留 / 0x01 VBUS
    application record element result: category=VALUE, type=uint8  # byte 1; bit 0-7bit / 0x00 成功 / 非0 错误码
  impl type McuPowerAck_Impl: category=STRUCTURE
    element ctrl_type: sw-bit-representation={bit-position=0, number-of-bits=8}, implementation-data-type=uint8_Impl  # byte 0; bit 0-7bit / 控制类型 0x00 保留 / 0x01 VBUS
    element result: sw-bit-representation={bit-position=0, number-of-bits=8}, implementation-data-type=uint8_Impl  # byte 1; bit 0-7bit / 0x00 成功 / 非0 错误码
  application record data type TimeZoneInfo: category=STRUCTURE
    application record element sign: category=VALUE, type=uint8  # byte 0; bit 0-7bit / 0x00 正数 / 0x01 负数
    application record element offset_seconds: category=VALUE, type=uint16  # byte 1-2; bit 0-15bit / 当前需要偏移的秒数
  impl type TimeZoneInfo_Impl: category=STRUCTURE
    element sign: sw-bit-representation={bit-position=0, number-of-bits=8}, implementation-data-type=uint8_Impl  # byte 0; bit 0-7bit / 0x00 正数 / 0x01 负数
    element offset_seconds: implementation-data-type=uint16_Impl  # byte 1-2; bit 0-15bit / 当前需要偏移的秒数
package /CDC7255/Interfaces
  sender receiver interface PowerOnHandshakeMtd  # pair_id=0x8100; msg_id=0x0100; direction=SOC_TO_MCU; type=event; tx_type=event; transport=spi&uart; qos= / 上电握手：SoC 启动后首先发送本命令与 MCU 建立通讯握手 1 秒内未收到 0x8100 需重发，握手成功后停放
    data MPURequestsDataSynchronization: type=MPU_REQ_DATA_SYNC  # io=NONE / MPU请求数据同步
  client server interface PowerOffReqMtd  # pair_id=0x8101; msg_id=0x0101; direction=SOC_TO_MCU; type=method(rr); tx_type=event; transport=spi&uart; qos= / SoC 主动向 MCU 请求睡眠或关机
    operation PowerOffReqMtd
      arg PowerReqCmd: type=POWER_REQ_CMD, direction=IN  # io=IN / 电源请求命令
  client server interface HeartbeatSetMtd  # pair_id=0x8102; msg_id=0x0102; direction=SOC_TO_MCU; type=method(rr); tx_type=event; transport=spi&uart; qos= / 心跳设置下发：开启/关闭 Comm UART 或 Fast UART 心跳
    operation HeartbeatSetMtd
      arg HeartbeatSet: type=HEARTBEAT_SET, direction=IN  # io=IN / 心跳设置状态
  sender receiver interface HeartbeatReqMtd  # pair_id=0x8103; msg_id=0x0103; direction=SOC_TO_MCU; type=event; tx_type=Cycle(1000ms); transport=spi&uart; qos= / 心跳请求：周期 1000ms 发送；握手后默认开启心跳
    data HeartbeatState: type=HEARTBEAT_STATE  # io=IN / 心跳状态
  client server interface PowerMgmtReqMtd  # pair_id=0x8105; msg_id=0x0105; direction=SOC_TO_MCU; type=method(rr); tx_type=event; transport=spi&uart; qos= / SoC 主动查询 MCU 的电源状态
    operation PowerMgmtReqMtd
  sender receiver interface StrStateFbMtd  # msg_id=0x0106; direction=SOC_TO_MCU; type=event; tx_type=event; transport=spi&uart; qos= / STR 状态反馈
    data STRState: type=STR_STATE  # io=IN / STR状态
  client server interface StrDebugSetMtd  # pair_id=0x811E; msg_id=0x011E; direction=SOC_TO_MCU; type=method(rr); tx_type=event; transport=spi&uart; qos= / SoC 向 MCU 通知 STR 最大维持时长
    operation StrDebugSetMtd
      arg StrMaxDuration: type=StrMaxDuration, direction=IN  # io=IN
  client server interface PowerStateSetMtd  # pair_id=0x8108; msg_id=0x0108; direction=SOC_TO_MCU; type=method(rr); tx_type=event; transport=spi&uart; qos= / SoC 向 MCU 同步自身电源状态
    operation PowerStateSetMtd
      arg powerState: type=IC_POWER_STATE, direction=IN  # io=IN / 高4bit OTA模式，低4bit SoC电源状态
  4 x sender receiver interface:
    PowerOffReqAckEvt  # pair_id=0x811F; msg_id=0x011F; direction=SOC_TO_MCU; type=event; tx_type=event; transport=spi&uart; qos=level1 / SoC 应答 MCU 关机通知
      data result: type=uint8  # io=OUT / 0=成功，非0=错误码
    BatteryStatusAckEvt  # pair_id=0x8107; msg_id=0x0107; direction=SOC_TO_MCU; type=event; tx_type=event; transport=spi&uart; qos=level1 / SoC 应答电压异常上报
      data result: type=uint8  # io=OUT / 0=成功，非0=错误码
    EnterStrAckEvt  # pair_id=0x810D; msg_id=0x010D; direction=SOC_TO_MCU; type=event; tx_type=event; transport=spi&uart; qos=level1 / SoC 应答进入 STR 通知
      data result: type=uint8  # io=OUT / 0=成功，非0=错误码
    WakeSocAckEvt  # pair_id=0x810E; msg_id=0x010E; direction=SOC_TO_MCU; type=event; tx_type=event; transport=spi&uart; qos=level1 / SoC 应答唤醒
      data result: type=uint8  # io=OUT / 0=成功，非0=错误码
  client server interface McuRestartReqMtd  # pair_id=0x810F; msg_id=0x010F; direction=SOC_TO_MCU; type=method(rr); tx_type=event; transport=spi&uart; qos=level1 / SoC 主动请求 MCU 对其重启
    operation McuRestartReqMtd
      arg restartType: type=RESTART_TYPE, direction=IN  # io=IN / 重启类型
  sender receiver interface KeyRestartAckEvt  # pair_id=0x8110; msg_id=0x0110; direction=SOC_TO_MCU; type=event; tx_type=event; transport=spi&uart; qos=level1 / SoC 回复按键结果
    data keyResult: type=uint8  # io=OUT / 0=NOK，1=OK
  sender receiver interface RtcRestartAckEvt  # pair_id=0x8111; msg_id=0x0111; direction=SOC_TO_MCU; type=event; tx_type=event; transport=spi&uart; qos=level1 / SoC 应答 RTC 重启请求
    data restartResult: type=uint8  # io=OUT / 0=OK，1=NOK
  sender receiver interface SocPowerCtrlAckEvt  # pair_id=0x8112; msg_id=0x0112; direction=SOC_TO_MCU; type=event; tx_type=event; transport=spi&uart; qos=level1 / SoC 应答外设供电控制
    data PeripheralPowerAck: type=PeripheralPowerAck  # io=OUT
  5 x client server interface:
    McuPowerCtrlReqMtd  # pair_id=0x8113; msg_id=0x0113; direction=SOC_TO_MCU; type=method(rr); tx_type=event; transport=spi&uart; qos=level1 / SoC 请求 MCU 控制某些外设电源
      operation McuPowerCtrlReqMtd
        arg McuPowerReq: type=McuPowerReq, direction=IN  # io=IN
    RtcTimeSetMtd  # pair_id=0x8114; msg_id=0x0114; direction=SOC_TO_MCU; type=method(rr); tx_type=event; transport=spi&uart; qos=level1 / SoC 向 MCU 通知 RTC 唤醒时间
      operation RtcTimeSetMtd
        arg DateTime: type=DateTime, direction=IN  # io=IN / 年/月/日/时/分/秒
    TimeZoneSetMtd  # pair_id=0x8115; msg_id=0x0115; direction=SOC_TO_MCU; type=method(rr); tx_type=event; transport=spi&uart; qos=level1 / SoC 向 MCU 通知当前时区
      operation TimeZoneSetMtd
        arg TimeZoneInfo: type=TimeZoneInfo, direction=IN  # io=IN
    SentryModeSetMtd  # pair_id=0x8116; msg_id=0x0116; direction=SOC_TO_MCU; type=method(rr); tx_type=event; transport=spi&uart; qos=level1 / SoC 通知 MCU 哨兵模式激活状态
      operation SentryModeSetMtd
        arg enable: type=uint8, direction=IN  # io=IN / 0=关闭，1=开启
    PetModeSetMtd  # pair_id=0x8117; msg_id=0x0117; direction=SOC_TO_MCU; type=method(rr); tx_type=event; transport=spi&uart; qos=level1 / SoC 通知 MCU 宠物模式激活状态
      operation PetModeSetMtd
        arg enable: type=uint8, direction=IN  # io=IN / 0=关闭，1=开启
  6 x sender receiver interface:
    BatteryVoltageAckEvt  # pair_id=0x8118; msg_id=0x0118; direction=SOC_TO_MCU; type=event; tx_type=event; transport=spi&uart; qos=level1 / SoC 应答电池电压
      data result: type=uint8  # io=OUT / 0=成功，非0=错误码
    VehicleSignalAckEvt  # pair_id=0x8119; msg_id=0x0119; direction=SOC_TO_MCU; type=event; tx_type=event; transport=spi&uart; qos=level1 / SoC 应答车身信号
      data result: type=uint8  # io=OUT / 0=成功，非0=错误码
    HeartbeatLostAckEvt  # pair_id=0x811A; msg_id=0x011A; direction=SOC_TO_MCU; type=event; tx_type=event; transport=spi&uart; qos=level1 / SoC 应答心跳丢失通知
      data result: type=uint8  # io=OUT / 0=OK，1=NOK
    HeartbeatRecoveredAckEvt  # pair_id=0x811B; msg_id=0x011B; direction=SOC_TO_MCU; type=event; tx_type=event; transport=spi&uart; qos=level1 / SoC 应答心跳恢复通知
      data result: type=uint8  # io=OUT / 0=OK，1=NOK
    TemperatureAbnormalAckEvt  # pair_id=0x811C; msg_id=0x011C; direction=SOC_TO_MCU; type=event; tx_type=event; transport=spi&uart; qos=level1 / SoC 应答温度异常上报
      data result: type=uint8  # io=OUT / 0=成功，非0=错误码
    HandshakeAckEvt  # pair_id=0x0100; msg_id=0x8100; direction=MCU_TO_SOC; type=event; tx_type=event; transport=spi&uart; qos= / MCU 回复 MPU 握手成功
      data Dummy: type=uint8  # no payload (protocol event has no parameters) / 协议事件无参数，占位
  client server interface PowerOffReqEvt  # pair_id=0x011F; msg_id=0x811F; direction=MCU_TO_SOC; type=method(rr); tx_type=event; transport=spi&uart; qos= / MCU 通知 SoC 关机（0x8101）
    operation PowerOffReqEvt
  client server interface HeartbeatSetStatusEvt  # pair_id=0x0102; msg_id=0x8102; direction=MCU_TO_SOC; type=method(rr); tx_type=event; transport=spi&uart; qos= / MCU 心跳开关状态上报
    operation HeartbeatSetStatusEvt
      arg HeartbeatStatus: type=HEARTBEAT_STATUS, direction=OUT  # io=OUT / 心跳开关状态
  sender receiver interface HeartbeatFeedbackEvt  # pair_id=0x0103; msg_id=0x8103; direction=MCU_TO_SOC; type=event; tx_type=event; transport=spi&uart; qos= / MCU 心跳反馈
    data Dummy: type=uint8  # no payload (protocol event has no parameters) / 协议事件无参数，占位
  client server interface PowerMgmtStatusEvt  # pair_id=0x0105; msg_id=0x8105; direction=MCU_TO_SOC; type=method(rr); tx_type=event; transport=spi&uart; qos= / MCU 电源管理状态上报
    operation PowerMgmtStatusEvt
      arg PowerManageStatus: type=POWER_MGMT_STATUS, direction=OUT  # io=OUT / 电源管理状态
  sender receiver interface AccStatusEvt  # msg_id=0x8106; direction=MCU_TO_SOC; type=event; tx_type=event; transport=spi&uart; qos= / MCU 上报 ACC 状态
    data ACC_Status: type=ACC_STATUS  # io=OUT / ACC状态
  client server interface BatteryStatusEvt  # pair_id=0x0107; msg_id=0x8107; direction=MCU_TO_SOC; type=method(rr); tx_type=event; transport=spi&uart; qos= / MCU 通知 SoC 电压异常（0x8107）：0超低压/1低压/2正常/3高压/4超高压/5断开
    operation BatteryStatusEvt
      arg batteryStatus: type=VOLTAGE_STATUS, direction=OUT  # io=OUT / 电压状态
  7 x sender receiver interface:
    ResetReasonEvt  # msg_id=0x811D; direction=MCU_TO_SOC; type=event; tx_type=event; transport=spi&uart; qos= / MCU 上报启动状态：复位原因值定义见 MCU 芯片手册
      data ResetReason: type=uint8  # io=OUT / 复位原因，值定义见 MCU 芯片手册
    AutosarNmModeEvt  # msg_id=0x810A; direction=MCU_TO_SOC; type=event; tx_type=event; transport=spi&uart; qos= / MCU 上报 Autosar 网络管理模式与状态
      data AutosarNmStatus: type=AutosarNmStatus  # io=OUT
    VehicleAntiTheftEvt  # msg_id=0x810B; direction=MCU_TO_SOC; type=event; tx_type=event; transport=spi&uart; qos= / MCU 上报车辆防盗状态
      data VehicleAntiCurrentSts: type=VEHICLE_ANTI_THEFT_STS  # io=OUT / 车辆防盗状态
    RemoteControlModeEvt  # msg_id=0x810C; direction=MCU_TO_SOC; type=event; tx_type=event; transport=spi&uart; qos= / MCU 上报远程控制模式
      data RemoteControlSt: type=REMOTE_CTRL_ST  # io=OUT / 远程控制模式
    PowerOffReqStatusEvt  # pair_id=0x0101; msg_id=0x8101; direction=MCU_TO_SOC; type=event; tx_type=event; transport=spi&uart; qos=level1 / MCU 应答 SoC 睡眠/关机请求：0=成功，非0=错误码
      data PowerOffReqResult: type=PowerOffReqResult  # io=OUT
    PowerStateSetStatusEvt  # pair_id=0x0108; msg_id=0x8108; direction=MCU_TO_SOC; type=event; tx_type=event; transport=spi&uart; qos=level1 / MCU 应答 SoC 电源状态同步
      data PowerStateSyncResult: type=PowerStateSyncResult  # io=OUT
    StrDebugSetStatusEvt  # pair_id=0x011E; msg_id=0x811E; direction=MCU_TO_SOC; type=event; tx_type=event; transport=spi&uart; qos=level1 / MCU 应答 STR 最大维持时长设置
      data StrMaxDuration: type=StrMaxDuration  # io=OUT
  client server interface EnterStrEvt  # pair_id=0x010D; msg_id=0x810D; direction=MCU_TO_SOC; type=method(rr); tx_type=event; transport=spi&uart; qos=level1 / MCU 通知 SoC 进入 STR
    operation EnterStrEvt
  client server interface WakeSocEvt  # pair_id=0x010E; msg_id=0x810E; direction=MCU_TO_SOC; type=method(rr); tx_type=event; transport=spi&uart; qos=level1 / MCU 唤醒 SoC
    operation WakeSocEvt
  sender receiver interface McuRestartAckEvt  # pair_id=0x010F; msg_id=0x810F; direction=MCU_TO_SOC; type=event; tx_type=event; transport=spi&uart; qos=level1 / MCU 应答 SoC 重启请求
    data result: type=uint8  # io=OUT / 0=成功，非0=错误码
  client server interface KeyRestartReqEvt  # pair_id=0x0110; msg_id=0x8110; direction=MCU_TO_SOC; type=method(rr); tx_type=event; transport=spi&uart; qos=level1 / MCU 因按键请求重启 SoC（有车速时 SoC 弹窗确认）
    operation KeyRestartReqEvt
  client server interface RtcRestartReqEvt  # pair_id=0x0111; msg_id=0x8111; direction=MCU_TO_SOC; type=method(rr); tx_type=event; transport=spi&uart; qos=level1 / MCU 因 RTC 定时时间到请求重启 SoC
    operation RtcRestartReqEvt
  client server interface SocPowerCtrlReqEvt  # pair_id=0x0112; msg_id=0x8112; direction=MCU_TO_SOC; type=method(rr); tx_type=event; transport=spi&uart; qos=level1 / MCU 向 SoC 请求对某些外设进行供电控制
    operation SocPowerCtrlReqEvt
      arg PeripheralPowerReq: type=PeripheralPowerReq, direction=IN  # io=IN
  5 x sender receiver interface:
    McuPowerCtrlAckEvt  # pair_id=0x0113; msg_id=0x8113; direction=MCU_TO_SOC; type=event; tx_type=event; transport=spi&uart; qos=level1 / MCU 应答外设电源控制
      data McuPowerAck: type=McuPowerAck  # io=OUT
    RtcTimeSetAckEvt  # pair_id=0x0114; msg_id=0x8114; direction=MCU_TO_SOC; type=event; tx_type=event; transport=spi&uart; qos=level1 / MCU 应答 RTC 时间设置
      data result: type=uint8  # io=OUT / 0=成功，非0=错误码
    TimeZoneSetAckEvt  # pair_id=0x0115; msg_id=0x8115; direction=MCU_TO_SOC; type=event; tx_type=event; transport=spi&uart; qos=level1 / MCU 应答时区设置
      data result: type=uint8  # io=OUT / 0=成功，非0=错误码
    SentryModeAckEvt  # pair_id=0x0116; msg_id=0x8116; direction=MCU_TO_SOC; type=event; tx_type=event; transport=spi&uart; qos=level1 / MCU 应答哨兵模式状态
      data result: type=uint8  # io=OUT / 0=成功，非0=错误码
    PetModeAckEvt  # pair_id=0x0117; msg_id=0x8117; direction=MCU_TO_SOC; type=event; tx_type=event; transport=spi&uart; qos=level1 / MCU 应答宠物模式状态
      data result: type=uint8  # io=OUT / 0=成功，非0=错误码
  7 x client server interface:
    BatteryVoltageEvt  # pair_id=0x0118; msg_id=0x8118; direction=MCU_TO_SOC; type=method(rr); tx_type=event; transport=spi&uart; qos=level1 / MCU 向 SoC 通知电池电压
      operation BatteryVoltageEvt
        arg voltage: type=uint16, direction=OUT  # io=OUT / 电池电压
    VehicleSignalEvt  # pair_id=0x0119; msg_id=0x8119; direction=MCU_TO_SOC; type=method(rr); tx_type=event; transport=spi&uart; qos=level1 / MCU 向 SoC 通知车身信号（IGN、车门等）
      operation VehicleSignalEvt
        arg VehicleSignalStatus: type=VehicleSignalStatus, direction=OUT  # io=OUT / IGN 状态与整车 IGN 状态
    HeartbeatLostEvt  # pair_id=0x011A; msg_id=0x811A; direction=MCU_TO_SOC; type=method(rr); tx_type=event; transport=spi&uart; qos=level1 / MCU 通知 SoC 其心跳已丢失
      operation HeartbeatLostEvt
    HeartbeatRecoveredEvt  # pair_id=0x011B; msg_id=0x811B; direction=MCU_TO_SOC; type=method(rr); tx_type=event; transport=spi&uart; qos=level1 / MCU 通知 SoC 心跳丢失现象已恢复
      operation HeartbeatRecoveredEvt
    TemperatureAbnormalEvt  # pair_id=0x011C; msg_id=0x811C; direction=MCU_TO_SOC; type=method(rr); tx_type=event; transport=spi&uart; qos=level1 / MCU 通知 SoC 温度异常
      operation TemperatureAbnormalEvt
        arg temperatureStatus: type=TEMPERATURE_STATUS, direction=OUT  # io=OUT / 温度状态
    SocFanQueryMtd  # pair_id=0x8802; msg_id=0x0801; direction=SOC_TO_MCU; type=method(rr); tx_type=; transport=; qos= / SOC 降温风扇查询：查询风扇速度
      operation SocFanQueryMtd
    SocFanCtrlMtd  # pair_id=0x8802; msg_id=0x0802; direction=SOC_TO_MCU; type=method(rr); tx_type=; transport=; qos= / SOC 降温风扇控制：通过 pwm 值调整风扇转速
      operation SocFanCtrlMtd
        arg pwm: type=uint8, direction=IN  # io=IN / PWM 值，范围 [0-100]
  5 x sender receiver interface:
    SocFanSpeedEvt  # msg_id=0x8802; direction=MCU_TO_SOC; type=event; tx_type=; transport=; qos= / SOC 降温风扇转速事件：控制与查询的响应都走这里
      data speed: type=uint16  # io=OUT / 风扇转速
    UpgradeCmdEvt  # msg_id=0x0C00; direction=SOC_TO_MCU; type=event; tx_type=event; transport=spi; qos= / SOC 通知 MCU 升级指令
      data UpgradeReqStatus: type=OTA_REQ_STS  # io=IN / 升级请求状态
    UpgradeFileInfoRspEvt  # pair_id=0x8C02; msg_id=0x0C02; direction=SOC_TO_MCU; type=event; tx_type=event; transport=spi; qos= / SOC 回复升级文件信息（0x8C02 的响应）
      data UpgradeFileInfo: type=UpgradeFileInfo  # io=IN
    UpgradeDataRspEvt  # pair_id=0x8C03; msg_id=0x0C03; direction=SOC_TO_MCU; type=event; tx_type=event; transport=spi; qos= / SOC 回复升级包数据（0x8C03 的响应）
      data UpgradeDataPkg: type=UpgradeDataPkg  # io=IN
    UpgradeStatusEvt  # msg_id=0x8C01; direction=MCU_TO_SOC; type=event; tx_type=event; transport=spi; qos= / MCU 通知 soc 升级状态
      data MCUUpgradeStatus: type=OTA_UPGRADE_STS  # io=OUT / 升级状态
  client server interface UpgradeFileInfoReqMtd  # pair_id=0x0C02; msg_id=0x8C02; direction=MCU_TO_SOC; type=method(rr); tx_type=event; transport=spi; qos= / MCU 请求升级文件信息
    operation UpgradeFileInfoReqMtd
      arg FrameUpgradeDataLen: type=uint16, direction=OUT  # io=OUT / 数据分包长度，大端字节序 （Byte0：FrameUpgradeDataLen_H） （Byte1：FrameUpgradeDataLen_L）
  client server interface UpgradeDataReqMtd  # pair_id=0x0C03; msg_id=0x8C03; direction=MCU_TO_SOC; type=method(rr); tx_type=event; transport=spi; qos= / MCU 请求升级包数据
    operation UpgradeDataReqMtd
      arg PkgSeq: type=uint32, direction=OUT  # io=OUT / 包序号 BYTE0-3，从 0 开始每次 +1，到 0xFFFFFFFF 后回 0
  client server interface TimeQueryMtd  # pair_id=0x8D01; msg_id=0x0D01; direction=SOC_TO_MCU; type=method(rr); tx_type=event; transport=uart; qos=level1 / SoC 查询 MCU 当前时间
    operation TimeQueryMtd
      arg DateTime: type=DateTime, direction=IN  # io=IN
  sender receiver interface TimeSetEvt  # msg_id=0x0D02; direction=SOC_TO_MCU; type=event; tx_type=event; transport=uart; qos=level1 / SoC 向 MCU 设置当前时间
    data DateTime: type=DateTime  # io=IN
  sender receiver interface TimeQueryAckEvt  # pair_id=0x0D01; msg_id=0x8D01; direction=MCU_TO_SOC; type=event; tx_type=event; transport=uart; qos=level1 / MCU 应答时间查询，返回当前时间
    data DateTime: type=DateTime  # io=OUT
  sender receiver interface TimeUploadEvt  # msg_id=0x8D02; direction=MCU_TO_SOC; type=event; tx_type=Cycle(60000ms); transport=uart; qos=level1 / MCU 每 1min 主动上传当前时间
    data DateTime: type=DateTime  # io=OUT
package /CDC7255/DataTypeMappingSets
  data type mapping set Protocol_MappingSet
    data-type-maps:
      application-data-type=uint16, implementation-data-type=uint16_Impl
      application-data-type=uint32, implementation-data-type=uint32_Impl
      application-data-type=uint8, implementation-data-type=uint8_Impl
      application-data-type=MPU_REQ_DATA_SYNC, implementation-data-type=MPU_REQ_DATA_SYNC_Impl
      application-data-type=RESET_TYPE, implementation-data-type=RESET_TYPE_Impl
      application-data-type=HEARTBEAT_SET, implementation-data-type=HEARTBEAT_SET_Impl
      application-data-type=HEARTBEAT_STATE, implementation-data-type=HEARTBEAT_STATE_Impl
      application-data-type=POWER_MGMT_REQ, implementation-data-type=POWER_MGMT_REQ_Impl
      application-data-type=STR_STATE, implementation-data-type=STR_STATE_Impl
      application-data-type=STR_DEBUG, implementation-data-type=STR_DEBUG_Impl
      application-data-type=IC_POWER_STATE, implementation-data-type=IC_POWER_STATE_Impl
      application-data-type=HEARTBEAT_STATUS, implementation-data-type=HEARTBEAT_STATUS_Impl
      application-data-type=POWER_MGMT_STATUS, implementation-data-type=POWER_MGMT_STATUS_Impl
      application-data-type=ACC_STATUS, implementation-data-type=ACC_STATUS_Impl
      application-data-type=BATTERY_STATUS, implementation-data-type=BATTERY_STATUS_Impl
      application-data-type=AUTOSAR_NM_MODE, implementation-data-type=AUTOSAR_NM_MODE_Impl
      application-data-type=AUTOSAR_NM_STATE, implementation-data-type=AUTOSAR_NM_STATE_Impl
      application-data-type=VEHICLE_ANTI_THEFT_STS, implementation-data-type=VEHICLE_ANTI_THEFT_STS_Impl
      application-data-type=REMOTE_CTRL_ST, implementation-data-type=REMOTE_CTRL_ST_Impl
      application-data-type=OTA_REQ_STS, implementation-data-type=OTA_REQ_STS_Impl
      application-data-type=OTA_UPGRADE_STS, implementation-data-type=OTA_UPGRADE_STS_Impl
      application-data-type=POWER_REQ_CMD, implementation-data-type=POWER_REQ_CMD_Impl
      application-data-type=TEMPERATURE_STATUS, implementation-data-type=TEMPERATURE_STATUS_Impl
      application-data-type=VOLTAGE_STATUS, implementation-data-type=VOLTAGE_STATUS_Impl
      application-data-type=RESTART_TYPE, implementation-data-type=RESTART_TYPE_Impl
      application-data-type=UpgradeDataPkg_upgrade_data_Array, implementation-data-type=UpgradeDataPkg_upgrade_data_Array_Impl
      application-data-type=DateTime, implementation-data-type=DateTime_Impl
      application-data-type=PeripheralStatus, implementation-data-type=PeripheralStatus_Impl
      application-data-type=AutosarNmStatus, implementation-data-type=AutosarNmStatus_Impl
      application-data-type=UpgradeFileInfo, implementation-data-type=UpgradeFileInfo_Impl
      application-data-type=UpgradeDataPkg, implementation-data-type=UpgradeDataPkg_Impl
      application-data-type=StrMaxDuration, implementation-data-type=StrMaxDuration_Impl
      application-data-type=VehicleSignalStatus, implementation-data-type=VehicleSignalStatus_Impl
      application-data-type=PowerOffReqResult, implementation-data-type=PowerOffReqResult_Impl
      application-data-type=PowerStateSyncResult, implementation-data-type=PowerStateSyncResult_Impl
      application-data-type=PeripheralPowerReq, implementation-data-type=PeripheralPowerReq_Impl
      application-data-type=PeripheralPowerAck, implementation-data-type=PeripheralPowerAck_Impl
      application-data-type=McuPowerReq, implementation-data-type=McuPowerReq_Impl
      application-data-type=McuPowerAck, implementation-data-type=McuPowerAck_Impl
      application-data-type=TimeZoneInfo, implementation-data-type=TimeZoneInfo_Impl
